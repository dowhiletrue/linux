## Documentation/devicetree/bindings/drm/i2c/tda998x.txt
```
Device-Tree bindings for the NXP TDA998x HDMI transmitter

Required properties;
  - compatible: must be "nxp,tda998x"

  - reg: I2C address

Optional properties:
  - interrupts: interrupt number and trigger type
	default: polling

  - pinctrl-0: pin control group to be used for
	screen plug/unplug interrupt.

  - pinctrl-names: must contain a "default" entry.

  - video-ports: 24 bits value which defines how the video controller
	output is wired to the TDA998x input - default: <0x230145>

	This property is not used when ports are defined.

Optional nodes:

  - port: up to three ports.
	The ports are defined according to [1].

    Video port.
	There may be only one video port.
	This one must contain the following property:

	- port-type: must be "rgb"

	and may contain the optional property:

	- reg: 24 bits value which defines how the video controller
		output is wired to the TDA998x input (video pins)
		When absent, the default value is <0x230145>.

    Audio ports.
	There may be one or two audio ports.
	These ones must contain the following properties:

	- port-type: must be "i2s" or "spdif"

	- reg: 8 bits value which defines how the audio controller
		output is wired to the TDA998x input (audio pins)

[1] Documentation/devicetree/bindings/graph.txt

Example:

	tda998x: hdmi-encoder {
		compatible = "nxp,tda998x";
		reg = <0x70>;
		interrupt-parent = <&gpio0>;
		interrupts = <27 2>;		/* falling edge */
		pinctrl-0 = <&pmx_camera>;
		pinctrl-names = "default";

		port@230145 {
			port-type = "rgb";
			reg = <0x230145>;
			hdmi_0: endpoint {
				remote-endpoint = <&lcd0_0>;
			};
		};
		port@3 {			/* AP1 = I2S */
			port-type = "i2s";
			reg = <0x03>;
			tda998x_i2s: endpoint {
				remote-endpoint = <&audio1_i2s>;
			};
		};
		port@4 {			 /* AP2 = S/PDIF */
			port-type = "spdif";
			reg = <0x04>;
			tda998x_spdif: endpoint {
				remote-endpoint = <&audio1_spdif1>;
			};
		};
	};
```
